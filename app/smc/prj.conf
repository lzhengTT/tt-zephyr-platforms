## sample.yaml
```
sample:
  description: Tenstorrent Blackhole Chip Management Firmware
  name: bh-cmfw
common:
  platform_allow:
    - tt_blackhole@p100/tt_blackhole/smc
    - tt_blackhole@p100a/tt_blackhole/smc
    - tt_blackhole@p150a/tt_blackhole/smc

tests:
  app.default: {}
  app.e2e-smoke:
    tags: e2e
    harness: pytest
    harness_config:
      pytest_root:
        - pytest/e2e_smoke.py
      pytest_args:
        - "--dut-scope=session"
        - "-m not flash"
  app.e2e-smoke-flash:
    tags: e2e-flash
    harness: pytest
    sysbuild: true
    harness_config:
      pytest_root:
        - pytest/e2e_smoke.py
      pytest_args:
        - "--dut-scope=session"
  app.recovery:
    build_only: true
    extra_overlay_confs:
      - recovery.conf
  app.recovery-flash:
    sysbuild: true
    tags: recovery
    harness: pytest
    harness_config:
      pytest_root:
        - pytest/recovery.py
      pytest_args:
        - "--dut-scope=session"
  app.vuart:
    tags: e2e
    harness: pytest
    harness_config:
      pytest_root:
        - pytest/vuart.py
      pytest_args:
        - "--dut-scope=session"
    extra_args:
      - "EXTRA_DTC_OVERLAY_FILE=vuart.overlay"
    extra_overlay_confs:
      - vuart.conf
  # demonstrates pinctrl driver, macros, etc, compile
  app.e2e_smoke.pinctrl:
    tags: e2e
    build_only: true
    extra_args:
      - "EXTRA_DTC_OVERLAY_FILE=pinctrl.overlay"
    extra_overlay_confs:
      - pinctrl.conf
```

## prj.conf
```kconfig
# console
CONFIG_CONSOLE=y
CONFIG_RAM_CONSOLE=y

# backlog of library drivers
CONFIG_TT_BH_ARC=y
CONFIG_TT_BOOT_FS=y

# logging
CONFIG_LOG=y
CONFIG_TT_APP_LOG_LEVEL_INF=y

CONFIG_ARC_USE_UNALIGNED_MEM_ACCESS=y
CONFIG_HW_STACK_PROTECTION=n
CONFIG_SYS_CLOCK_TICKS_PER_SEC=1000

# I2C
CONFIG_MULTI_LEVEL_INTERRUPTS=y
CONFIG_I2C_DW=y
CONFIG_I2C=y
CONFIG_I2C_TARGET=y
CONFIG_SMBUS=y

# protobufs
CONFIG_NANOPB=y

# stack
# These default to 1024 on ARC.
CONFIG_MAIN_STACK_SIZE=2048
CONFIG_SYSTEM_WORKQUEUE_STACK_SIZE=2048

# perform driver-library fw and hw init prior to the application
CONFIG_TT_BH_ARC_SYSINIT=y

# Disable printing the default Zephyr boot banner
CONFIG_BOOT_BANNER=n
# Print the Tenstorrent boot banner + git version on startup
CONFIG_TT_BOOT_BANNER=y
CONFIG_TT_BOOT_BANNER_GIT_VERSION=y
CONFIG_TT_BOOT_BANNER_SDK_VERSION=y

CONFIG_CLOCK_CONTROL=y
```

## src/main.c
```c
/*
 * Copyright (c) 2024 Tenstorrent AI ULC
 * SPDX-License-Identifier: Apache-2.0
 */

#include "cm2dm_msg.h"
#include "dvfs.h"
#include "fan_ctrl.h"
#include "fw_table.h"
#include "init_common.h"
#include "smbus_target.h"
#include "telemetry.h"
#include "status_reg.h"
#include "reg.h"

#include <stdint.h>

#include <app_version.h>
#include <tenstorrent/msgqueue.h>
#include <tenstorrent/uart_tt_virt.h>
#include <tenstorrent/post_code.h>
#include <zephyr/init.h>
#include <zephyr/kernel.h>
#include <zephyr/logging/log.h>

LOG_MODULE_REGISTER(main, CONFIG_TT_APP_LOG_LEVEL);

int main(void)
{
	SetPostCode(POST_CODE_SRC_CMFW, POST_CODE_ZEPHYR_INIT_DONE);
	printk("Tenstorrent Blackhole CMFW %s\n", APP_VERSION_STRING);

	if (!IS_ENABLED(CONFIG_TT_SMC_RECOVERY)) {
		if (get_fw_table()->feature_enable.aiclk_ppm_en) {
			STATUS_ERROR_STATUS0_reg_u error_status0 = {
				.val = ReadReg(STATUS_ERROR_STATUS0_REG_ADDR)
			};

			if (error_status0.f.regulator_init_error) {
				LOG_ERR("Not enabling AICLK PPM due to regulator init error.\n");
			} else {
				/* DVFS should get enabled if AICLK PPM or L2CPUCLK PPM is enabled
				 * We currently don't have plans to implement L2CPUCLK PPM,
				 * so currently, dvfs_enable == aiclk_ppm_enable
				 */
				InitDVFS();
			}
		}
	}

	init_msgqueue();

	if (!IS_ENABLED(CONFIG_TT_SMC_RECOVERY)) {
		init_telemetry(APPVERSION);
		if (get_fw_table()->feature_enable.fan_ctrl_en) {
			init_fan_ctrl();
		}

		if (!IS_ENABLED(CONFIG_TT_AUTO_RESET)) {
			UpdateAutoResetTimeoutRequest(0);
		}

		/* These timers are split out from their init functions since their work tasks have
		 * i2c conflicts with other init functions.
		 *
		 * Note: The above issue would be solved by using Zephyr's driver model.
		 */
		StartTelemetryTimer();
		if (dvfs_enabled) {
			StartDVFSTimer();
		}
	}

	Dm2CmReadyRequest();

	while (1) {
		k_msleep(1000);
	}

	return 0;
}

#define FW_VERSION_SEMANTIC APPVERSION
#define FW_VERSION_DATE     0x00000000
#define FW_VERSION_LOW      0x00000000
#define FW_VERSION_HIGH     0x00000000

uint32_t FW_VERSION[4] __attribute__((section(".fw_version"))) = {
	FW_VERSION_SEMANTIC, FW_VERSION_DATE, FW_VERSION_LOW, FW_VERSION_HIGH};

static int _InitFW(void)
{
	return InitFW(APPVERSION);
}

SYS_INIT(_InitFW, APPLICATION, UTIL_DEC(CONFIG_TT_BH_ARC_SYSINIT_PRIORITY));

#ifdef CONFIG_UART_TT_VIRT
#include "status_reg.h"

void uart_tt_virt_init_callback(const struct device *dev, size_t inst)
{
	sys_write32((uint32_t)(uintptr_t)uart_tt_virt_get(dev), STATUS_FW_VUART_REG_ADDR(inst));
}
#endif
```
